## CMakeLists.txt
```
#
# Copyright (c) 2026 Nordic Semiconductor ASA
#
# SPDX-License-Identifier: LicenseRef-Nordic-5-Clause
#

cmake_minimum_required(VERSION 3.20.0)

find_package(Zephyr REQUIRED HINTS $ENV{ZEPHYR_BASE})
project(aliro-nfc-user-device)

target_sources(app PRIVATE src/main.cpp)
target_include_directories(app PRIVATE src)

add_subdirectory(src/platform/nfc)
add_subdirectory(src/platform/os)
add_subdirectory(src/platform/crypto)
add_subdirectory(src/platform/authorization)
add_subdirectory(src/storage/credential)
add_subdirectory(src/storage/key)
add_subdirectory(src/storage/mailbox)
add_subdirectory(src/storage/document)
add_subdirectory(src/cli)
```

## Kconfig
```
#
# Copyright (c) 2026 Nordic Semiconductor ASA
#
# SPDX-License-Identifier: LicenseRef-Nordic-5-Clause
#

mainmenu "Aliro NFC User Device"

module = ALIRO_UD_APP
module-str = ALIRO_UD_APP
module-dep = LOG
module-help = Enables Aliro NFC User Device application log messages.
source "$(ZEPHYR_BASE)/subsys/logging/Kconfig.template.log_config"

rsource "src/platform/Kconfig"
rsource "src/storage/credential/Kconfig"
rsource "src/storage/key/Kconfig"
rsource "src/storage/mailbox/Kconfig"
rsource "src/storage/document/Kconfig"

rsource "Kconfig.defconfig"

source "Kconfig.zephyr"
```

## prj.conf
```kconfig
#
# Copyright (c) 2026 Nordic Semiconductor ASA
#
# SPDX-License-Identifier: LicenseRef-Nordic-5-Clause
#

#
# Aliro User Device stack (Aliro::UserDeviceStack facade, checked out under
# the "ncs-aliro" west project). Kconfig/CMake integration is supplied by the
# module itself; no manual link wiring is added here.
#
CONFIG_NCS_ALIRO_USER_DEVICE=y

#
# NFC-A Type 4 Tag/ISO-DEP listen-mode transport (AWP1). Raw ISO-DEP mode
# only: no NDEF payload is registered.
#
CONFIG_NFC_T4T_NRFXLIB=y

# Basic system configuration
CONFIG_CPP=y
CONFIG_STD_CPP17=y
CONFIG_REQUIRES_FULL_LIBCPP=y

#
# SYS_INIT hooks (including AWP4's authorization button/LED init) and
# `main()`'s own boot sequencing all run on the main thread's stack before
# the scheduler starts other threads. On-target this faulted with a
# `K_ERR_STACK_CHK_FAIL` UsageFault (PSP reaching PSPLIM exactly) inside
# CONFIG_LOG_MODE_IMMEDIATE's synchronous log-formatting/GRTC-timestamp call
# chain (`msg_process` -> `z_log_msg_runtime_vcreate` -> ... ->
# `sys_clock_cycle_get_32`) once AWP4 added another SYS_INIT hook; the
# original 4096 B evidently left too little headroom for that call depth.
# See docs/evidence/AWP4.md for the captured crash. Doubling restores
# headroom without materially affecting the RAM budget.
#
CONFIG_MAIN_STACK_SIZE=8192
CONFIG_SYSTEM_WORKQUEUE_STACK_SIZE=2048

CONFIG_LOG=y
CONFIG_LOG_MODE_IMMEDIATE=y
CONFIG_NCS_ALIRO_USER_DEVICE_LOG_LEVEL_DBG=y

#
# k_poll() multiplexes the NFC/stack worker thread's wait between the
# coalesced field-lifecycle semaphore and the bounded command/stack-event
# queue (AWP1 lifecycle-race fix; see nfc_worker.cpp).
#
CONFIG_POLL=y

CONFIG_CONSOLE=y
CONFIG_UART_CONSOLE=y

#
# Development CLI over the DK virtual UART (AWP2): Zephyr shell on the same
# UART as the console, at the board's default 115200-8N1. See
# `src/cli/cli.cpp` for the "aliro-ud" root command.
#
CONFIG_SHELL=y
#
# "aliro-ud credential set-access-document"/"set-revocation-document" take
# a hex-encoded document up to CONFIG_ALIRO_UD_DOCUMENT_MAX_SIZE (default
# 1024) bytes wide (APP_PLAN.md AWP3); the shell command buffer must fit
# the longest such line: command prefix (~40 chars) + 2 hex chars/byte.
CONFIG_SHELL_CMD_BUFF_SIZE=2200

#
# On-target "aliro-ud credential commit" (AWP6 DK bring-up) faulted with a
# stack-overflow UsageFault on the `shell_uart` thread at the default 2048 B
# `CONFIG_SHELL_STACK_SIZE`: `PersistedCredential` (two embedded 1024 B
# `OptionalDocument` buffers plus a 16-entry `Binding` array, ~3 KB) is
# built up on that thread's stack across the staging-transaction call chain
# before being copied into the committed store (same class of issue as the
# AWP5 host-test `CONFIG_ZTEST_STACK_SIZE` fix in
# tests/.../crypto/prj.conf, but never previously hit here because no AWP
# before this one exercised a real interactive "credential commit" over
# the DK's shell). See docs/evidence/AWP6.md for the captured crash.
CONFIG_SHELL_STACK_SIZE=16384
```

## src/main.cpp
```c
/*
 * Copyright (c) 2026 Nordic Semiconductor ASA
 *
 * SPDX-License-Identifier: LicenseRef-Nordic-5-Clause
 */

#include <zephyr/kernel.h>
#include <zephyr/logging/log.h>

#include <aliro/user_device/user_device.h>

#include "platform/nfc/nfc_transport.h"
#include "platform/os/app_status.h"
#include "storage/credential/credential_store.h"
#include "storage/key/persistent_key_store.h"
#include "storage/mailbox/mailbox_store.h"

LOG_MODULE_REGISTER(aliro_nfc_ud, LOG_LEVEL_INF);

/*
 * main() performs boot sequencing only (see docs/architecture.md).
 * Authorization and the development CLI are implemented in their own
 * modules starting with later AWPs; none of that protocol or platform
 * behavior belongs here. Credential/trust persistence (AWP3) is
 * initialized here because it must run its boot-time transaction-journal
 * recovery before the NFC transport starts (a session must never observe
 * a half-committed credential record).
 */
int main(void)
{
	LOG_INF("Aliro NFC User Device");

	const AliroError credentialError = AliroUd::Credential::Store::Init();
	if (credentialError != ALIRO_NO_ERROR) {
		LOG_ERR("Credential store initialization failed: %d", credentialError.ToInt());
		AliroUd::AppStatus::SetInitState(AliroUd::AppStatus::InitState::StackInitFailed);
		return 0;
	}

	/*
	 * Kpersistent records are keyed by credential handle, so this must
	 * initialize after the credential store above.
	 */
	const AliroError persistentKeyError = AliroUd::PersistentKey::Store::Init();
	if (persistentKeyError != ALIRO_NO_ERROR) {
		LOG_ERR("Persistent key store initialization failed: %d", persistentKeyError.ToInt());
		AliroUd::AppStatus::SetInitState(AliroUd::AppStatus::InitState::StackInitFailed);
		return 0;
	}

	/*
	 * Mailbox byte storage (AWP6) is keyed by credential handle and reads
	 * mailbox configuration live from the credential store, so it must
	 * initialize after the credential store above.
	 */
	const AliroError mailboxError = AliroUd::Mailbox::Store::Init();
	if (mailboxError != ALIRO_NO_ERROR) {
		LOG_ERR("Mailbox store initialization failed: %d", mailboxError.ToInt());
		AliroUd::AppStatus::SetInitState(AliroUd::AppStatus::InitState::StackInitFailed);
		return 0;
	}

	const AliroError err = Aliro::UserDeviceStack::Instance().Init();

	if (err != ALIRO_NO_ERROR) {
		/*
		 * AliroError::ToString() is declared in the shared aliro/errors.h
		 * header but its definition (stack/src/errors/errors.cpp) is only
		 * built for CONFIG_NCS_ALIRO (Reader); a User-Device-only build
		 * cannot link it. Use the numeric code instead of narrowing this
		 * skeleton around that gap; see docs/evidence/AWP0.md.
		 */
		LOG_ERR("User Device stack initialization failed: %d", err.ToInt());
		AliroUd::AppStatus::SetInitState(AliroUd::AppStatus::InitState::StackInitFailed);
		return 0;
	}

	LOG_INF("User Device stack initialized");

	/*
	 * Starts the dedicated NFC/stack worker thread and NFC-A Type 4
	 * Tag/ISO-DEP listen-mode transport (AWP1). Field activation/removal
	 * and command APDUs are mapped to UserDeviceStack session lifecycle
	 * calls on that worker thread from here on; main() has no further
	 * role to play.
	 */
	if (AliroUd::Nfc::Start() != 0) {
		LOG_ERR("NFC transport initialization failed");
		AliroUd::AppStatus::SetInitState(AliroUd::AppStatus::InitState::NfcStartFailed);
		return 0;
	}

	AliroUd::AppStatus::SetInitState(AliroUd::AppStatus::InitState::Running);

	return 0;
}
```
