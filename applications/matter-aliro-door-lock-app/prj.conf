## Kconfig
```
#
# Copyright (c) 2025 Nordic Semiconductor ASA
#
# SPDX-License-Identifier: LicenseRef-Nordic-5-Clause
#

mainmenu "nRF Door Lock and Access Control Add-on"

module = DOOR_LOCK_APP
module-str = NCS_DOOR_LOCK_APP
module-dep = LOG
module-help = Enables nRF Connect SDK Door Lock Application log messages.
source "$(ZEPHYR_BASE)/subsys/logging/Kconfig.template.log_config"

config DOOR_LOCK_CLI
	bool "CLI support"
	default y if !DOOR_LOCK_RELEASE
	select SHELL
	select REBOOT
	select DOOR_LOCK_ALIRO_READER_STORAGE_SHELL
	help
	  Enable support for Door Lock CLI.

config DOOR_LOCK_RELEASE
    bool "Release configuration"
    help
      In this configuration:
      Aliro stack logs are disabled.
      RFAL NFC driver logs are disabled.
      Shell commands are disabled.
      Device reset automatically on fatal error.

config DOOR_LOCK_DISPLAY
	bool "Enable display"
	help
	  Show distance, front/back detection, and lock state on the TFT display.
	  Enable through the display snippet.

rsource "src/Kconfig"

if DOOR_LOCK_DISPLAY
rsource "src/display/Kconfig"
endif # DOOR_LOCK_DISPLAY

rsource "Kconfig.defconfig"

# Source BLE defconfig when any BLE feature is enabled
if DOOR_LOCK_BLE_UWB || DOOR_LOCK_DFU_SMP_SERVICE || DOOR_LOCK_NUS_SERVICE
rsource "Kconfig.ble.defconfig"
endif # DOOR_LOCK_BLE_UWB || DOOR_LOCK_DFU_SMP_SERVICE || DOOR_LOCK_NUS_SERVICE

rsource "Kconfig.crypto.defconfig"

rsource "src/matter/Kconfig"
source "$(ZEPHYR_CONNECTEDHOMEIP_MODULE_DIR)/config/nrfconnect/chip-module/Kconfig.features"
source "$(ZEPHYR_CONNECTEDHOMEIP_MODULE_DIR)/config/nrfconnect/chip-module/Kconfig.defaults"

source "Kconfig.zephyr"
```

## prj.conf
```kconfig
#
# Copyright (c) 2025 Nordic Semiconductor ASA
#
# SPDX-License-Identifier: LicenseRef-Nordic-5-Clause
#

#
# Aliro
#

CONFIG_NCS_ALIRO=y
CONFIG_DOOR_LOCK_ALIRO_LOCK_SIM=y
CONFIG_DOOR_LOCK_ALIRO_LOCK_SIM_MOVEMENT_TIME_MS=200

# Basic system configuration
CONFIG_CPP=y
CONFIG_STD_CPP17=y
CONFIG_REQUIRES_FULL_LIBCPP=y
CONFIG_RESET_ON_FATAL_ERROR=n
CONFIG_ASSERT=y
CONFIG_MPU_STACK_GUARD=y
CONFIG_SYS_HEAP_RUNTIME_STATS=y
CONFIG_THREAD_NAME=y

# Stack sizes
CONFIG_SYSTEM_WORKQUEUE_STACK_SIZE=3072
CONFIG_SHELL_STACK_SIZE=4096

# Logging
CONFIG_CONSOLE=y
CONFIG_LOG=y
CONFIG_LOG_MODE_DEFERRED=y
CONFIG_LOG_BUFFER_SIZE=4096
CONFIG_DOOR_LOCK_RFAL_LOG_LEVEL_DBG=y
CONFIG_DOOR_LOCK_ALIRO_UWB_LOG_LEVEL_INF=y
CONFIG_USE_SEGGER_RTT=n
CONFIG_LOG_BACKEND_RTT=n
CONFIG_LOG_BACKEND_SHOW_COLOR=n
CONFIG_DOOR_LOCK_APP_LOG_LEVEL_INF=y
CONFIG_BT_HCI_CORE_LOG_LEVEL_ERR=y
CONFIG_BT_HCI_DRIVER_LOG_LEVEL_ERR=y
CONFIG_MATTER_LOG_LEVEL_INF=y
CONFIG_CHIP_APP_LOG_LEVEL=3

# Disable unused shell features
CONFIG_SHELL_VT100_COLORS=n
CONFIG_SHELL_HISTORY=n
CONFIG_SHELL_WILDCARD=n

# Set shell configuration
CONFIG_SHELL_MINIMAL=n
CONFIG_SHELL_DEVICE_HELPERS=y

# Increase shell buffer sizes
CONFIG_SHELL_BACKEND_SERIAL_RX_RING_BUFFER_SIZE=2048
CONFIG_SHELL_BACKEND_SERIAL_TX_RING_BUFFER_SIZE=1024

# Adjust logs queue size
CONFIG_SHELL_BACKEND_SERIAL_LOG_MESSAGE_QUEUE_SIZE=2048

# Workaround for Murata issue:
# https://github.com/aliro-access-control/aliro-actuator/issues/114
CONFIG_BT_GAP_AUTO_UPDATE_CONN_PARAMS=n

#
# Matter
#

# Enable CHIP
CONFIG_CHIP=y
CONFIG_CHIP_DEVICE_PRODUCT_NAME="Door Lock"

# Enable Matter extended announcement and increase duration to 1 hour.
CONFIG_CHIP_BLE_EXT_ADVERTISING=y
CONFIG_CHIP_BLE_ADVERTISING_DURATION=60

# Enable Factory Data feature
CONFIG_CHIP_FACTORY_DATA=y
CONFIG_CHIP_FACTORY_DATA_BUILD=y

# Enable DK library
CONFIG_DK_LIBRARY=y

# Increase BT RX stack size to prevent stack overflow during BLE pairing
# Note: This workaround will be resolved in ncs v3.2.0 release
CONFIG_BT_RX_STACK_SIZE=2048

# Increase the heap size to 16K as Aliro+Matter configuration requires more memory.
# It's visible when working with ecosystems.
CONFIG_CHIP_MALLOC_SYS_HEAP_SIZE=16384

# Disable all logs by default to save memory,
# except those explicitly enabled for Matter and Aliro related.
CONFIG_LOG_DEFAULT_LEVEL=0

CONFIG_CHIP_NFC_ONBOARDING_PAYLOAD=n
CONFIG_CHIP_QSPI_NOR_POWER_MANAGEMENT_SUPPORT=n

# Required for Time Synchronization cluster
CONFIG_CHIP_ENABLE_READ_CLIENT=y

# Enable Matter shell
CONFIG_CHIP_LIB_SHELL=y
CONFIG_MATTER_TEST_SHELL=y

# Enable Matter Access module
CONFIG_DOOR_LOCK_MATTER_ACCESS=y
CONFIG_DOOR_LOCK_MATTER_ACCESS_CREDENTIAL_TYPES_PIN=y
CONFIG_DOOR_LOCK_MATTER_ACCESS_CREDENTIAL_TYPES_ALIRO=y
CONFIG_DOOR_LOCK_MATTER_ACCESS_MAX_CREDENTIAL_LENGTH=65

# Override default discriminator (3003) and passcode (30033003)
CONFIG_CHIP_DEVICE_DISCRIMINATOR=0xBBB
CONFIG_CHIP_DEVICE_SPAKE2_PASSCODE=30033003

# 32774 == 0x8006 (example lock-app)
CONFIG_CHIP_DEVICE_PRODUCT_ID=32774

# Suspend devices when the CPU goes into sleep
CONFIG_PM_DEVICE=y
CONFIG_PM_DEVICE_RUNTIME=y

# Try to disable unused RAM blocks to reduce power consumption
CONFIG_RAM_POWER_DOWN_LIBRARY=y

# Allow application tasks to capture an Aliro public key and operation source.
CONFIG_MATTER_APP_TASK_MAX_SIZE=72
```

## src/main.cpp
```c
/*
 * Copyright (c) 2025 Nordic Semiconductor ASA
 *
 * SPDX-License-Identifier: LicenseRef-Nordic-5-Clause
 */

#include "matter/init.h"

#include "aliro/utils.h"

#include <crypto_utils/crypto_utils.h>
#include <zephyr/logging/log.h>

#include <cstdlib>

#ifdef CONFIG_DOOR_LOCK_BLE_UWB
#include "access_manager.h"
#include "uwb_impl.h"
#include <aliro/aliro.h>
#endif // CONFIG_DOOR_LOCK_BLE_UWB

#ifdef CONFIG_DOOR_LOCK_GESTURE_ACCESS
#include <gesture_access/gesture_access.h>
#endif // CONFIG_DOOR_LOCK_GESTURE_ACCESS

LOG_MODULE_REGISTER(app, CONFIG_CHIP_APP_LOG_LEVEL);

int main()
{
	auto error = DoorLock::CryptoUtils::Init();
	VerifyOrDie(error == ALIRO_NO_ERROR, "Failed to initialize crypto utils");

#ifdef CONFIG_DOOR_LOCK_BLE_UWB

	constexpr Aliro::Uwb::UltraWideBand::Callbacks uwbCallbacks{
		.mRangingData =
			[](Aliro::Uwb::UltraWideBand::SessionContextHandle sessionContext,
			   const Aliro::UwbRangingData &uwbData) {
				Aliro::AccessManagerInstance().HandleRangingSessionData(sessionContext, uwbData);
			},
		.mRangingSessionStateChanged =
			[](Aliro::Uwb::UltraWideBand::SessionContextHandle sessionContext,
			   Aliro::RangingSessionState state) {
				Aliro::AccessManagerInstance().HandleRangingSessionStateChanged(sessionContext, state);
			},
		.mBleMessageTransmit =
			+[](Aliro::Uwb::UltraWideBand::SessionContextHandle sessionContext, const uint8_t *data,
			    size_t length) {
				Aliro::AliroStack::Instance().SendBleMessage(sessionContext, data, length);
			},
	};

	int uwbError = Aliro::Uwb::UltraWideBandInstance().Init(uwbCallbacks);
	if (uwbError == -ENOSYS) {
		LOG_INF("UWB is not implemented");
	} else if (uwbError != 0) {
		LOG_ERR("Failed to initialize UWB module: %d", uwbError);
	} else if (uwbError == 0) {
		auto *fwVersion = Aliro::Uwb::UltraWideBandInstance().GetFirmwareVersion();
		LOG_INF("UWB FW: %s", fwVersion ? fwVersion : "N/A");
	}

#endif // CONFIG_DOOR_LOCK_BLE_UWB

#ifdef CONFIG_DOOR_LOCK_GESTURE_ACCESS
	int gestureAccessErr = DoorLock::GestureAccess::Init([] {
		Aliro::AccessManagerInstance().HandleGestureDetected();
	});
	VerifyOrDie(gestureAccessErr == 0, "Failed to initialize gesture access");
#endif // CONFIG_DOOR_LOCK_GESTURE_ACCESS

	int err = StartMatter();
	VerifyOrDie(err == EXIT_SUCCESS, "Failed to start Matter");

	return EXIT_SUCCESS;
}
```
